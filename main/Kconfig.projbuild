## main/Kconfig.projbuild
```kconfig
menu "Screen board"

choice SCREEN_BOARD
    prompt "Target board"
    default SCREEN_BOARD_CROWPANEL_7
    help
        Selects the display driver. Everything else is board independent.

        wave (Waveshare ESP32-S3-LCD-1.47B) is back, so display_st7789.c is
        back with it: an ST7789 over SPI. Two boards that drove one over SPI
        have been and gone -- an Adafruit Feather ESP32-S3 TFT and a
        NiceMCU-32S-DEV 2.8IPS -- and their targets went out with them, but
        the driver serves wave again.

config SCREEN_BOARD_CROWPANEL_7
    bool "Elecrow CrowPanel 7.0 HMI (800x480, 16-bit RGB)"

config SCREEN_BOARD_TDISPLAY_S3
    bool "LilyGO T-Display-S3 (ST7789 320x170, 8-bit i80)"

config SCREEN_BOARD_WAVESHARE_147B
    bool "Waveshare ESP32-S3-LCD-1.47B (ST7789 320x172, SPI, onboard IMU)"

config SCREEN_BOARD_TOUCH_LCD_35B
    bool "Waveshare ESP32-S3-Touch-LCD-3.5B (AXS15231B 320x480, QSPI)"

config SCREEN_BOARD_TOUCH_LCD_147
    bool "Waveshare ESP32-S3-Touch-LCD-1.47 (JD9853 172x320, SPI, env sensors)"
    help
        envo. The JD9853 variant of the 1.47" board (wave is the 1.47B, an
        ST7789). Same 172x320 glass, a different controller over SPI --
        display_jd9853.c and the vendored esp_lcd_jd9853 component. An
        environment logger: an RTC, a BME280 and an ENS160+AHT21 soldered to
        the board's I2C header (GPIO42/41), read into the env pages and logged
        both to flash and, every 30 s, to the microSD card.

        NOT the plain ESP32-S3-LCD-1.47, which is an ST7789 on different pins
        with a WS2812 on GPIO38 (our SCLK here) -- if the panel stays dark and
        nothing answers on GPIO42/41, that is the board you have.

config SCREEN_BOARD_TOUCH_LCD_169
    bool "Waveshare ESP32-S3-LCD-1.69 (ST7789V2 240x280, SPI, portrait)"
    help
        watch. The unit is the plain ESP32-S3-LCD-1.69, with NO touch (the
        symbol's name predates finding that out). A small portrait panel, a
        QMI8658 IMU, a PCF85063 clock and a LiPo charger whose power latch
        (SYS_EN) the firmware must hold high or the board switches itself off
        on battery. Runs a grand-complication analog face and the sand. See
        docs/superpowers/specs/2026-09-24-watch-grand-complication-design.md.

config SCREEN_BOARD_AUDIO_S3
    bool "Waveshare ESP32-S3-AUDIO-Board (noise monitor)"
    help
        speaker. No screen: two analog mics into an ES7210, an ES8311 and a
        small amp for the speaker, a ring of seven WS2812, a PCF85063 clock, a
        TCA9555 expander and a microSD slot. It runs its own app,
        speaker_app.c, called from the top of app_main -- a noise monitor
        that shows the room's level on the ring and logs it to the card --
        and none of the page UI. See
        docs/superpowers/specs/2026-09-25-speaker-noise-monitor-design.md and,
        before touching the expander, the boot_safety section of
        docs/hardware/speaker-pinout.md.

endchoice

config SCREEN_DEVICE_NAME
    string "Advertised BLE name"
    default "big" if SCREEN_BOARD_CROWPANEL_7
    default "lilly" if SCREEN_BOARD_TDISPLAY_S3
    default "wave" if SCREEN_BOARD_WAVESHARE_147B
    default "envio" if SCREEN_BOARD_TOUCH_LCD_35B
    default "envo" if SCREEN_BOARD_TOUCH_LCD_147
    default "watch" if SCREEN_BOARD_TOUCH_LCD_169
    default "speaker" if SCREEN_BOARD_AUDIO_S3
    default "small"
    help
        The name this board advertises. Give each board on your desk a
        distinct name so `tell --device NAME` can pick between them.

config SCREEN_I2C_SDA
    int "I2C SDA pin"
    default 19 if SCREEN_BOARD_CROWPANEL_7
    default 18 if SCREEN_BOARD_TDISPLAY_S3
    default 48 if SCREEN_BOARD_WAVESHARE_147B
    default 8 if SCREEN_BOARD_TOUCH_LCD_35B
    default 42 if SCREEN_BOARD_TOUCH_LCD_147
    default 11 if SCREEN_BOARD_TOUCH_LCD_169
    default 11 if SCREEN_BOARD_AUDIO_S3
    default 42
    help
        The CrowPanel wires its GT911 touch controller to GPIO19/20. The
        Feather's STEMMA QT port is GPIO42/41, from Adafruit's board variant.
        The T-Display-S3 brings its bus out on GPIO18/17. The Waveshare
        1.47B wires its onboard QMI8658 to GPIO48/47. The NiceMCU brings its
        CST816D out on GPIO33/32, and the gas sensor shares that bus.

        envio (Touch-LCD-3.5B) hangs everything off one bus on GPIO8/7: the
        AXP2101 PMIC, the AXS15231B touch, a QMI8658, a PCF85063 RTC and a
        TCA9554 expander. The display itself is QSPI, not on here.

        speaker (AUDIO-Board) has one bus on GPIO11/10 for everything: both
        codecs, the TCA9555 and the PCF85063.

config SCREEN_I2C_SCL
    int "I2C SCL pin"
    default 20 if SCREEN_BOARD_CROWPANEL_7
    default 17 if SCREEN_BOARD_TDISPLAY_S3
    default 47 if SCREEN_BOARD_WAVESHARE_147B
    default 7 if SCREEN_BOARD_TOUCH_LCD_35B
    default 41 if SCREEN_BOARD_TOUCH_LCD_147
    default 10 if SCREEN_BOARD_TOUCH_LCD_169
    default 10 if SCREEN_BOARD_AUDIO_S3
    default 41

config SCREEN_BRIGHTNESS
    int "Panel brightness, 0 to 100"
    range 0 100
    default 100
    help
        A lit panel is the largest steady draw on these boards and most of
        what makes them warm. Full brightness is rarely needed on a desk.

config SCREEN_BUTTON_A
    int "First button pin, or -1 for none"
    default 0 if SCREEN_BOARD_TDISPLAY_S3
    default 0 if SCREEN_BOARD_WAVESHARE_147B
    default 0 if SCREEN_BOARD_TOUCH_LCD_35B
    default 0 if SCREEN_BOARD_TOUCH_LCD_147
    default 0 if SCREEN_BOARD_TOUCH_LCD_169
    default 0 if SCREEN_BOARD_AUDIO_S3
    default -1
    help
        GPIO0 is the BOOT button on both of these boards. It is a strapping
        pin, so holding it through a reset still enters the bootloader, but
        once running it is an ordinary input with a pull-up.

        With two buttons the first goes back and the second forward. With only
        one, a tap goes forward and holding it goes back, because a board with
        one button still needs both directions.

config SCREEN_BUTTON_B
    int "Second button pin, or -1 for none"
    default 14 if SCREEN_BOARD_TDISPLAY_S3
    default -1
    help
        The Waveshare 1.47B has two buttons on it but only one that software
        can see: its other key pulls EN to ground and is a hardware reset.

config SCREEN_ENV_ONLY
    bool "Show only the clock and the room readings"
    default n
    help
        Makes the board an environment logger and nothing else: the clock,
        and a page each for temperature, humidity and pressure, charted from
        the log in flash.

        Everything else is dropped from the build -- the sand, the spirit
        level, the shake timer, the stopwatch, the clock chip's own page and
        the die-against-crystal chart -- along with the IMU driver they
        needed. A board doing one job well is easier to read at a glance than
        one offering nine things, and the freed RAM goes to the charts.

        Needs a BME280 for the readings and an envlog partition to keep them.

config SCREEN_ENV_DEMO
    bool "Fill an empty log with invented readings"
    default n
    help
        Writes a few days of plausible indoor weather into an empty log, so
        the charts can be looked at before the sensors are wired.

        Only ever into an EMPTY log, and only when no sensor answered: it will
        not overwrite readings and it will not run beside real ones. Every
        record it writes carries ENV_SYNTHETIC, so invented data cannot be
        mistaken for measured data later, by a person or by a tool.

        Turn it off and erase the log once the sensors are in.

config SCREEN_VIVID_PALETTE
    bool "Use the vivid accent colours rather than the colour-blind-safe set"
    default y
    help
        The vivid set, chosen on the hardware: Okabe-Ito is a print palette
        and print is not backlit, so on a lit panel its colours read as washed
        out rather than as restrained.

        Turning this off returns the Okabe-Ito accents, which stay apart under
        the common forms of colour blindness. What is given up by leaving it on
        is that at full saturation the orange and the vermillion sit closer
        together for a deuteranope, and the charts use that pair to mean
        different things -- though never colour alone: every bar on every chart
        here carries a text label as well.

config SCREEN_CLOCK_MS
    bool "Show thousandths on the clock"
    default n if SCREEN_ENV_ONLY
    default y
    help
        Thousandths cost a redraw every frame instead of every second, which
        is most of what a board does while the clock is showing. On a display
        of Claude's usage that is a fair price for a clock that visibly runs.

        An environment logger is a quiet instrument that sits still, and a
        digit flickering thirty times a second is at odds with that -- as well
        as being the largest thing it does with its processor for no reading
        anyone takes.

config SCREEN_ROTATE_SECS
    int "Seconds on each page before moving to the next, or 0 to stay put"
    default 20 if SCREEN_BOARD_TDISPLAY_S3
    default 0
    help
        A board with no touch panel and two buttons is better at showing you
        things in turn than at being navigated. Rotation makes the pages a
        slideshow you watch rather than a menu you drive, and it replaces the
        screensaver: nothing sits still long enough to burn in, so the saver
        has nothing left to protect.

        A button press holds the current page for a minute before the
        rotation picks up again. Pages struck off the round on the menu, and
        the ones that are never in it -- the sand, the level, a running
        stopwatch -- are left out here too.

        0 leaves the display wherever it was last put, which is what the big
        panel and the Feather do.

        envio stays put on Pip, her home face, rather than rotating: a desk
        familiar you glance at is not a slideshow. Her other subsystems become
        pages you can reach once touch is wired.

config SCREEN_I2C_AUX_SDA
    int "Second I2C SDA pin, or -1 for none"
    default 10 if SCREEN_BOARD_WAVESHARE_147B
    default -1
    help
        A second bus, for chips added to pins the first one cannot reach.
        wave's QMI8658 is soldered to GPIO48/47 and neither comes out to her
        header, so anything wired on later -- a DS3231, say -- cannot join
        that bus. GPIO10 and GPIO11 are on her header and used by nothing.

        -1 means the board has no second bus, which is not a failure: the
        drivers simply do without.

config SCREEN_I2C_AUX_SCL
    int "Second I2C SCL pin, or -1 for none"
    default 11 if SCREEN_BOARD_WAVESHARE_147B
    default -1

config SCREEN_HAVE_CAMERA
    bool "Board carries an OV5640 on a DVP header"
    default y if SCREEN_BOARD_TOUCH_LCD_35B
    default n
    help
        Only envio (Touch-LCD-3.5B) has the 24-pin DVP header the OV5640
        rides on, so this is the only board that pulls in camera.c and the
        esp32-camera component. Guards camera.c's body and its header
        include so a board without the header never pulls in esp_camera.h
        or its symbols.

config SCREEN_ALTITUDE_M
    int "Height above sea level in metres, or 0 for no correction"
    default 179 if SCREEN_BOARD_TOUCH_LCD_35B
    default 0
    help
        Corrects a BME280's station pressure to sea level (the figure
        forecasts quote) before it is logged. envio sits in North
        York/Willowdale, about 179 m ASL -- not the 76 m of the lakeshore.
        0 disables the correction, which is right for a board with no
        barometer.

config SCREEN_PRESSURE_CAL_X10
    int "Fixed pressure trim in tenths of a hPa (calibration)"
    default 51 if SCREEN_BOARD_TOUCH_LCD_35B
    default 0
    help
        Added to the sea-level pressure after the altitude correction, to
        cancel the barometer's absolute bias against a trusted reference. In
        tenths of a hPa: 51 = +5.1 hPa. envio's BMP280 read 5.1 hPa below a
        phone's sea-level pressure (1013.9 vs 1019), so it is trimmed up.

endmenu
```

## stan-claw/sdkconfig.defaults
```kconfig
CONFIG_IDF_TARGET="esp32s3"
CONFIG_ESPTOOLPY_FLASHSIZE_16MB=y
CONFIG_ESPTOOLPY_FLASHMODE_QIO=y
CONFIG_PARTITION_TABLE_CUSTOM=y
CONFIG_PARTITION_TABLE_CUSTOM_FILENAME="partitions.csv"
CONFIG_ESP_DEFAULT_CPU_FREQ_MHZ_240=y
CONFIG_COMPILER_OPTIMIZATION_PERF=y

CONFIG_SPIRAM=y
CONFIG_SPIRAM_MODE_OCT=y
CONFIG_SPIRAM_SPEED_80M=y
CONFIG_SPIRAM_USE_MALLOC=y
CONFIG_SPIRAM_TRY_ALLOCATE_WIFI_LWIP=y
CONFIG_MBEDTLS_EXTERNAL_MEM_ALLOC=y
CONFIG_SPIRAM_FETCH_INSTRUCTIONS=y
CONFIG_SPIRAM_RODATA=y
CONFIG_LCD_RGB_RESTART_IN_VSYNC=y

CONFIG_ESP_MAIN_TASK_STACK_SIZE=8192
CONFIG_ESP_TASK_WDT_TIMEOUT_S=20
CONFIG_ESP_TASK_WDT_PANIC=y

CONFIG_MBEDTLS_CERTIFICATE_BUNDLE=y
CONFIG_MBEDTLS_CERTIFICATE_BUNDLE_DEFAULT_FULL=y
CONFIG_MBEDTLS_SSL_IN_CONTENT_LEN=16384
CONFIG_ESP_HTTP_CLIENT_ENABLE_HTTPS=y
CONFIG_LWIP_SNTP_MAX_SERVERS=2
CONFIG_HTTPD_MAX_REQ_HDR_LEN=1024

CONFIG_ESP_CONSOLE_UART_DEFAULT=y
CONFIG_ESP_CONSOLE_UART_BAUDRATE=115200
CONFIG_LOG_DEFAULT_LEVEL_INFO=y
```

## tiny2-voice/sdkconfig.defaults
```kconfig
CONFIG_IDF_TARGET="esp32s3"
CONFIG_ESPTOOLPY_FLASHSIZE_16MB=y
CONFIG_PARTITION_TABLE_SINGLE_APP_LARGE=y

# The console is the CP2102 on UART0 (the "COM" port).
CONFIG_ESP_CONSOLE_UART_DEFAULT=y
# ESP32-S3R8: 8 MB octal PSRAM.
CONFIG_SPIRAM=y
CONFIG_SPIRAM_MODE_OCT=y
CONFIG_SPIRAM_SPEED_80M=y
CONFIG_SPIRAM_USE_MALLOC=y
CONFIG_ESP_DEFAULT_CPU_FREQ_MHZ_240=y

# HTTPS to ElevenLabs.
CONFIG_MBEDTLS_CERTIFICATE_BUNDLE=y
CONFIG_MBEDTLS_CERTIFICATE_BUNDLE_DEFAULT_FULL=y
CONFIG_HTTPD_MAX_REQ_HDR_LEN=1024
```
